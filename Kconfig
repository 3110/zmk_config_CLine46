## Kconfig
```kconfig
# CLine46 固有の設定。この設定リポジトリは Zephyr モジュールとして
# 読み込まれる（build.yaml が渡す ZMK_EXTRA_MODULES）

menuconfig CLINE46_STATUS_ADV
    bool "CLine46: キーボードの状態を BLE 広告で流す"
    depends on ZMK_BLE
    select BT_EXT_ADV
    select HWINFO
    help
      レイヤー・電池・接続状態などを BLE の非接続広告に載せて 1 秒ごとに
      流す。受信側（M5Stack など）はスキャンするだけでよく、接続も
      ペアリングも要らないので BLE プロファイルを消費しない。
      ZMK 自身の広告と衝突しないよう拡張広告のセットを別に確保するため、
      CONFIG_BT_EXT_ADV を有効にする。Central（右手）に入れること。
      ペイロードの定義は include/cline46/status_adv.h を参照。

if CLINE46_STATUS_ADV

config CLINE46_STATUS_ADV_INTERVAL_MS
    int "広告の間隔（ミリ秒、操作中）"
    default 1000
    range 100 10000
    help
      短くすると表示の追従が良くなるが、そのぶん電池を食う。

config CLINE46_STATUS_ADV_IDLE_INTERVAL_MS
    int "広告の間隔（ミリ秒、アイドル中）"
    default 10000
    range 1000 60000
    help
      CONFIG_ZMK_IDLE_TIMEOUT を過ぎてアイドルに入ったあとの間隔。
      ディープスリープに入ると広告そのものを止める。

config CLINE46_STATUS_ADV_INIT_PRIORITY
    int "初期化の優先度（APPLICATION レベル内）"
    default 50
    range 0 99
    help
      リセット原因（hwinfo）を zmk-feature-watchdog が消すより前に読むため、
      既定の APPLICATION 優先度（90）より小さい値にしてある。

config CLINE46_STATUS_ADV_DEFAULT_ON
    bool "起動直後から広告を出す"
    default y
    help
      保存された設定が無いとき（初回起動や設定リセットの後）にどちらから
      始めるか。&status_adv で切り替えたあとは、そちらが優先される
      （CONFIG_CLINE46_STATUS_ADV_PERSIST が有効な場合）。
      n にすると、使うときだけキーで入れる運用になる。

config CLINE46_STATUS_ADV_PERSIST
    bool "&status_adv での切り替えを保存する"
    depends on SETTINGS
    default y
    help
      オン/オフを settings に保存して、次の起動でも引き継ぐ。
      無効にすると、起動のたびに CONFIG_CLINE46_STATUS_ADV_DEFAULT_ON の
      状態に戻る。書き込みは ZMK 本体と同じく少し遅らせてまとめるので、
      連打してもフラッシュを余計に減らさない。

config CLINE46_STATUS_ADV_START_DELAY_S
    int "起動してから広告を始めるまでの秒数"
    default 3
    range 0 60
    help
      BLE スタックの初期化を待つための猶予。待っている間は 1 秒ごとに
      bt_is_ready() を見て再試行するので、短すぎても失敗はしない。

endif # CLINE46_STATUS_ADV

config CLINE46_STATUS_PERIPHERAL_VOLTAGE
    bool "CLine46: 左手の電池電圧を split 経由で中継する"
    depends on ZMK_SPLIT && ZMK_SPLIT_RELAY_EVENT
    help
      ZMK の split が運ぶ電池情報は残量(%)だけで電圧が入っていないため、
      cormoran fork の汎用イベント中継に相乗りして左手の電圧を右手へ送る。
      **左右の両方で有効にすること**（左手＝送る側、右手＝受けて広告に載せる側）。
      既存の split 接続に相乗りするので、電波も電池消費も増えない。

# 拡張広告のセットは ZMK 本体の広告（セット0）とこちら（セット1）で 2 つ要る
configdefault BT_EXT_ADV_MAX_ADV_SET
    default 2 if CLINE46_STATUS_ADV
```

## config/west.yml
```yaml
manifest:
  remotes:
    - name: cormoran
      url-base: https://github.com/cormoran
    - name: badjeff    # <-- PMW3610
      url-base: https://github.com/badjeff
    - name: caksoylar  # <-- RGB LED
      url-base: https://github.com/caksoylar
    - name: takamaru-fpv  # <-- Battery level smoothing
      url-base: https://github.com/takamaru-fpv

  projects:
    # ZMK: DYA Studio 用カスタム RPC サブシステム付き cormoran fork。
    # v0.3 系ではマクロ/コンボのモジュールが Zephyr 3.7 以降の書き方
    # (configdefault / ROM_SECTIONS)を使っていて通らなかったため、
    # main+dya(Zephyr v4.1.0+zmk-fixes)に移行した。
    # Zephyr は ZMK 側の app/west.yml から入るのでここで指定しない
    - name: zmk
      remote: cormoran
      # main+dya @ 2026-07-25 (Zephyr v4.1.0+zmk-fixes)
      revision: e5c9b6915b56801193e359dd9bad4a167ce0d1b8
      import: app/west.yml
    - name: zmk-feature-non-lipo-battery-management
      remote: takamaru-fpv
      revision: voltage_division

    # DYA Studio モジュール（すべて cormoran リポジトリ）。
    # main 追従で breaking change の実績があるため、タグのあるもの以外は
    # コミット SHA で固定する
    - name: zmk-module-ble-management
      remote: cormoran
      # main @ 2026-07-05 (このモジュールには zmk-v0.4.0.0 タグが未発行)
      revision: 57738cc4fc6ba80e82a7ac57741a0339cb186cd4
    - name: zmk-module-battery-history
      remote: cormoran
      # main @ 2026-02-24 (タグ無し)
      revision: 307755dd2ad4d320e14de162e8e5ef018f29d929
    - name: zmk-module-settings-rpc
      remote: cormoran
      # main @ 2026-07-06 (このモジュールには zmk-v0.4.0.0 タグが未発行)
      revision: 78f86df9e6c5edaf57bef3ccbd7f360cfdf49291
    - name: zmk-module-runtime-input-processor
      remote: cormoran
      revision: zmk-v0.4.0.0

    # マクロ/コンボを DYA Studio から編集するためのモジュール。
    # zmk-feature-custom-settings は他 2 つの依存
    - name: zmk-feature-custom-settings
      remote: cormoran
      revision: c6a7fef3a3be3d3ace5de9a4b0628c6418cd1f3f
    - name: zmk-feature-runtime-macro
      remote: cormoran
      revision: 38530962eb7061b60efcb98e84585cfb1f0cb6de
    - name: zmk-feature-runtime-combo
      remote: cormoran
      revision: d9490e7b5d41c516221d131241009e81740efcee

    # 切り分け用のモジュール。押下キーの可視化とハード診断で、
    # 「押したキーがどの position として認識されているか」を
    # DYA Studio 上で確認できるようにするためのもの
    - name: zmk-feature-input-stream
      remote: cormoran
      revision: aeb015908a42a7615ccdccc7feb3a10d23132a71
    - name: zmk-feature-device-info
      remote: cormoran
      revision: 8cedd2dd9f04e19ea5a17b94914dd47a09d8db11
    - name: zmk-feature-kscan-diagnostics
      remote: cormoran
      revision: 1432f7fe0cfe903cd7d3c9931ae6bd6f2e1f328e

    # 接続先ごとの既定レイヤー。
    # main 側にはビヘイビア（&df）しか無く Studio RPC が入っていないため、
    # DYA Studio の Connection タブから設定するには custom-rpc-rewrite の
    # 方が必要（cormoran 氏自身も dya2 でこちらを使っている）。
    # ブランチ名のとおり作業中の系統なので SHA で固定する。
    # なお import: true は使わない。このモジュールの west 依存が
    # custom-settings を main で参照しており、上で SHA 固定している
    # ものと衝突するため（west update がエラーになる）
    - name: zmk-feature-default-layer
      remote: cormoran
      # codex/custom-rpc-rewrite @ 2026-07-15
      revision: b25cb5b324da2d9bbc84e1877c775f5b2b7c6845
    # default-layer の zephyr/module.yml が build.depends で os-detection を
    # 要求するため、機能を使わなくてもモジュールを置いておく必要がある
    # （無いと「Unmet or cyclic dependencies in modules」で configure が
    # 止まる）。CONFIG_ZMK_OS_DETECTION は無効なのでコードは入らない
    - name: zmk-feature-os-detection
      remote: cormoran
      # main @ 2026-07-19
      revision: 3052679f645b8fc1997275c2eaa6b86bdd55ca01

    # ハングやフォールトの記録と自動復帰
    - name: zmk-feature-watchdog
      remote: cormoran
      revision: 84ad14c6c3645dc40b23f45d08ab45418655f912

    # DYA Studio のキーマップ読み込みを速くする
    - name: zmk-feature-fast-keymap
      remote: cormoran
      revision: 8dac76de0ba38588ba39ca498910e24f8332bc6b
    # プレビューにトラックボールを描く（CLine46_R.overlay のノード参照）
    - name: zmk-feature-module-physical-layout
      remote: cormoran
      revision: 4f18de45dc27820725d267916b4cdacc0e0b6cf9

    # その他のモジュール
    - name: zmk-pmw3610-driver
      remote: badjeff
      revision: main
    - name: zmk-rgbled-widget
      remote: caksoylar
      revision: main
  self:
    path: config
```

## dts/bindings/behaviors/cline46,behavior-status-adv.yaml
```yaml
# Copyright (c) 2026 3110
# SPDX-License-Identifier: MIT

description: Behavior to turn the CLine46 status advertisement on and off

compatible: "cline46,behavior-status-adv"

include: one_param.yaml
```
